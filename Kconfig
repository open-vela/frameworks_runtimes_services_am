## Kconfig
```kconfig
#
# Copyright (C) 2023 Xiaomi Corporation
#
# Licensed under the Apache License, Version 2.0 (the "License");
# you may not use this file except in compliance with the License.
# You may obtain a copy of the License at
#
#      http://www.apache.org/licenses/LICENSE-2.0
#
# Unless required by applicable law or agreed to in writing, software
# distributed under the License is distributed on an "AS IS" BASIS,
# WITHOUT WARRANTIES OR CONDITIONS OF ANY KIND, either express or implied.
# See the License for the specific language governing permissions and
# limitations under the License.
#

config SYSTEM_ACTIVITY_SERVICE
	tristate "Enable Activity Manager Service"
	default n
	depends on ANDROID_BINDER
	depends on SYSTEM_SERVER
	depends on SYSTEM_PACKAGE_SERVICE

if SYSTEM_ACTIVITY_SERVICE

config AM_COMMAND
	tristate "Enable am command tools"
	default n

endif
```
